## OpenDoor20260427/app/sdkconfig.defaults
```kconfig
CONFIG_HTTPD_MAX_REQ_HDR_LEN=2048
CONFIG_ENABLE_MDNS=y
CONFIG_PARTITION_TABLE_TWO_OTA=y
CONFIG_MBEDTLS_SSL_IN_CONTENT_LEN=4096
CONFIG_MBEDTLS_SSL_OUT_CONTENT_LEN=2048
```
